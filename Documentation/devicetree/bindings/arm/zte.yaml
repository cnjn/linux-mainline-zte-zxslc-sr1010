## Documentation/devicetree/bindings/pwm/zte,zx279133-pwm.yaml
```yaml
# SPDX-License-Identifier: (GPL-2.0-only OR BSD-2-Clause)
%YAML 1.2
---
$id: http://devicetree.org/schemas/pwm/zte,zx279133-pwm.yaml#
$schema: http://devicetree.org/meta-schemas/core.yaml#

title: ZTE ZX279133 PWM controller

maintainers:
  - ZTE Linux Team <zte.linux@gmail.com>

description:
  The ZX279133 PWM controller provides four channels. Each channel has a
  10-bit clock divider and 16-bit period and duty counters.

allOf:
  - $ref: pwm.yaml#

properties:
  compatible:
    const: zte,zx279133-pwm

  reg:
    maxItems: 1

  clocks:
    items:
      - description: Peripheral bus clock
      - description: Waveform generator clock

  clock-names:
    items:
      - const: pclk
      - const: wclk

  "#pwm-cells":
    const: 3

required:
  - compatible
  - reg
  - clocks
  - clock-names
  - "#pwm-cells"

unevaluatedProperties: false

examples:
  - |
    #include <dt-bindings/clock/zte,zx279133-lsp.h>

    pwm@14f10000 {
        compatible = "zte,zx279133-pwm";
        reg = <0x14f10000 0x1000>;
        clocks = <&lsp1_clk ZX279133_LSP1_CLK_PWM_PCLK>,
                 <&lsp1_clk ZX279133_LSP1_CLK_PWM_WCLK>;
        clock-names = "pclk", "wclk";
        #pwm-cells = <3>;
    };
```

## Documentation/devicetree/bindings/reset/zte,zx296718-reset.yaml
```yaml
# SPDX-License-Identifier: GPL-2.0-only OR BSD-2-Clause
%YAML 1.2
---
$id: http://devicetree.org/schemas/reset/zte,zx296718-reset.yaml#
$schema: http://devicetree.org/meta-schemas/core.yaml#

title: ZTE ZX296718 reset controller

maintainers:
  - cnjn <1779895255@qq.com>

description:
  The ZTE ZX296718 reset controller provides active-low reset signals to SoC
  peripherals. Each reset line is controlled by one bit in a bank of 32-bit
  registers.

properties:
  compatible:
    const: zte,zx296718-reset

  reg:
    maxItems: 1

  '#reset-cells':
    const: 1
    description: Bit index of the reset signal within the register bank

required:
  - compatible
  - reg
  - '#reset-cells'

additionalProperties: false

examples:
  - |
    reset-controller@10e10060 {
        compatible = "zte,zx296718-reset";
        reg = <0x10e10060 0x4>;
        #reset-cells = <1>;
    };

...
```

## Documentation/devicetree/bindings/soc/zte,zx279133-pwm-audit.yaml
```yaml
# SPDX-License-Identifier: (GPL-2.0-only OR BSD-2-Clause)
%YAML 1.2
---
$id: http://devicetree.org/schemas/soc/zte,zx279133-pwm-audit.yaml#
$schema: http://devicetree.org/meta-schemas/core.yaml#

title: ZTE ZX279133 PWM read-only audit

maintainers:
  - ZTE Linux Team <zte.linux@gmail.com>

description: |
  This diagnostic node reads the raw MODE, PERIOD, and DUTY registers of the
  firmware-configured PWM controller. It does not register a PWM provider,
  prepare or enable clocks, request resets, select pinctrl, or modify controller
  state. The clock references let the driver refuse MMIO access unless firmware
  has already enabled both controller gates at their expected rates.

properties:
  compatible:
    const: zte,zx279133-pwm-audit

  reg:
    maxItems: 1

  clocks:
    maxItems: 2

  clock-names:
    items:
      - const: pclk
      - const: wclk

required:
  - compatible
  - reg
  - clocks
  - clock-names

additionalProperties: false

examples:
  - |
    pwm-audit@14f10000 {
        compatible = "zte,zx279133-pwm-audit";
        reg = <0x14f10000 0x1000>;
        clocks = <&lsp1_clk 6>, <&lsp1_clk 7>;
        clock-names = "pclk", "wclk";
    };
...
```

## Documentation/devicetree/bindings/soc/zte,zx279133-xpcs-nppt-audit.yaml
```yaml
# SPDX-License-Identifier: (GPL-2.0-only OR BSD-2-Clause)
%YAML 1.2
---
$id: http://devicetree.org/schemas/soc/zte,zx279133-xpcs-nppt-audit.yaml#
$schema: http://devicetree.org/meta-schemas/core.yaml#

title: ZTE ZX279133 XPCS and NPPT read-only audit

maintainers:
  - cnjn <1779895255@qq.com>

description: |
  This diagnostic-only node is instantiated only by a dedicated diagnostic
  overlay supplied by an external build, never by a normal system DTS. It
  takes a single, read-only snapshot of firmware-configured XPCS identification
  and state registers and NPPT shadow registers when userspace first reads its
  snapshot attribute. It does not provide an XPCS, PCS, PHY, MAC, or packet
  processor and must not be used as a functional hardware description.

properties:
  compatible:
    const: zte,zx279133-xpcs-nppt-audit

  reg:
    minItems: 3
    maxItems: 3

  reg-names:
    items:
      - const: xpcs0
      - const: xpcs1
      - const: nppt

  clocks:
    minItems: 2
    maxItems: 2

  clock-names:
    items:
      - const: xpcs-pclk
      - const: nppt-wclk

required:
  - compatible
  - reg
  - reg-names
  - clocks
  - clock-names

additionalProperties: false

examples:
  - |
    audit@1a000000 {
        compatible = "zte,zx279133-xpcs-nppt-audit";
        reg = <0x1a000000 0x00200000>,
              <0x1b000000 0x00200000>,
              <0x19000000 0x00001000>;
        reg-names = "xpcs0", "xpcs1", "nppt";
        clocks = <&topcrm 18>, <&topcrm 20>;
        clock-names = "xpcs-pclk", "nppt-wclk";
    };
...
```

## Documentation/devicetree/bindings/soc/zte/zte,zx279133-idm-cci.yaml
```yaml
# SPDX-License-Identifier: (GPL-2.0-only OR BSD-2-Clause)
%YAML 1.2
---
$id: http://devicetree.org/schemas/soc/zte/zte,zx279133-idm-cci.yaml#
$schema: http://devicetree.org/meta-schemas/core.yaml#

title: ZTE ZX279133 IDM CCI access control

maintainers:
  - cnjn <1779895255@qq.com>

description:
  Two system-control words configure the IDM interfaces used by the network
  DMA engine. The Ethernet driver snapshots them before enabling the vendor
  Linux value and restores them after the IDM path is stopped.

properties:
  compatible:
    items:
      - const: zte,zx279133-idm-cci
      - const: syscon

  reg:
    maxItems: 1

required:
  - compatible
  - reg

additionalProperties: false

examples:
  - |
    syscon@10e00078 {
        compatible = "zte,zx279133-idm-cci", "syscon";
        reg = <0x10e00078 0x8>;
    };

...
```

## Documentation/devicetree/bindings/soc/zte/zte,zx279133-pon-route.yaml
```yaml
# SPDX-License-Identifier: (GPL-2.0-only OR BSD-2-Clause)
%YAML 1.2
---
$id: http://devicetree.org/schemas/soc/zte/zte,zx279133-pon-route.yaml#
$schema: http://devicetree.org/meta-schemas/core.yaml#

title: ZTE ZX279133 PON SerDes route control

maintainers:
  - cnjn <1779895255@qq.com>

description:
  The route control selects whether the PON SerDes is connected to XMAC1.
  It is separate from the PON protocol register block and is consumed by the
  NPPT Ethernet controller for the direct WAN path.

properties:
  compatible:
    items:
      - const: zte,zx279133-pon-route
      - const: syscon

  reg:
    maxItems: 1

required:
  - compatible
  - reg

additionalProperties: false

examples:
  - |
    syscon@17000080 {
        compatible = "zte,zx279133-pon-route", "syscon";
        reg = <0x17000080 0x4>;
    };

...
```

## Documentation/devicetree/bindings/spi/zte,zx279133-sfc.yaml
```yaml
# SPDX-License-Identifier: GPL-2.0-only OR BSD-2-Clause
%YAML 1.2
---
$id: http://devicetree.org/schemas/spi/zte,zx279133-sfc.yaml#
$schema: http://devicetree.org/meta-schemas/core.yaml#

title: ZTE ZX279133 SPI flash controller

maintainers:
  - cnjn <1779895255@qq.com>

description: |
  The ZX279133 serial flash controller is a single-chip-select SPI-MEM
  controller used by the board's SPI-NAND. The controller has a 64-byte FIFO
  and supports single-bit command phases with single, dual, or quad address
  and data phases.

allOf:
  - $ref: spi-controller.yaml#

properties:
  compatible:
    const: zte,zx279133-sfc

  reg:
    maxItems: 1

  interrupts:
    maxItems: 1

  clocks:
    minItems: 2
    maxItems: 2

  clock-names:
    items:
      - const: pclk
      - const: wclk

  resets:
    maxItems: 1

  zte,spi-chipselect:
    description:
      Phandle to the LSP syscon, register offset, and mask used to select the
      controller chip-select. The single board device uses bit 29 of offset
      0x2c and selects chip-select zero.
    $ref: /schemas/types.yaml#/definitions/phandle-array
    items:
      - items:
          - description: phandle to the LSP syscon
          - description: chip-select register offset
          - description: chip-select mask

  spi-max-frequency:
    description: Maximum SPI clocking speed of the controller in Hz.
    $ref: /schemas/types.yaml#/definitions/uint32

required:
  - compatible
  - reg
  - interrupts
  - clocks
  - clock-names
  - resets
  - zte,spi-chipselect
  - spi-max-frequency

unevaluatedProperties: false

examples:
  - |
    spi@10d0f000 {
        compatible = "zte,zx279133-sfc";
        reg = <0x10d0f000 0x1000>;
        interrupts = <33>;
        clocks = <&sfc_clk 0>, <&sfc_clk 1>;
        clock-names = "pclk", "wclk";
        resets = <&sfc_clk 0>;
        zte,spi-chipselect = <&sfc_clk 0x2c 0x20000000>;
        spi-max-frequency = <100000000>;
        #address-cells = <1>;
        #size-cells = <0>;

        flash@0 {
            compatible = "spi-nand";
            reg = <0>;
            spi-max-frequency = <100000000>;
        };
    };

...
```
