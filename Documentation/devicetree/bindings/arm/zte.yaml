## Documentation/devicetree/bindings/net/zte,sr1010-rtl8372n-id-audit.yaml
```yaml
# SPDX-License-Identifier: GPL-2.0-only OR BSD-2-Clause
%YAML 1.2
---
$id: http://devicetree.org/schemas/net/zte,sr1010-rtl8372n-id-audit.yaml#
$schema: http://devicetree.org/meta-schemas/core.yaml#

title: ZTE SR1010 RTL8372N read-only chip ID audit

maintainers:
  - cnjn <1779895255@qq.com>

description:
  A test-only, non-PHY MDIO child used to perform two fixed read-only chip ID
  transactions against the RTL8372N switch. The audit is not present in normal
  SR1010 device trees.

properties:
  compatible:
    const: zte,sr1010-rtl8372n-id-audit

  reg:
    const: 29

required:
  - compatible
  - reg

additionalProperties: false

examples:
  - |
    mdio {
        #address-cells = <1>;
        #size-cells = <0>;

        switch-id-audit@1d {
            compatible = "zte,sr1010-rtl8372n-id-audit";
            reg = <0x1d>;
        };
    };

...
```

## Documentation/devicetree/bindings/net/zte,sr1010-zx279051-audit.yaml
```yaml
# SPDX-License-Identifier: GPL-2.0-only OR BSD-2-Clause
%YAML 1.2
---
$id: http://devicetree.org/schemas/net/zte,sr1010-zx279051-audit.yaml#
$schema: http://devicetree.org/meta-schemas/core.yaml#

title: ZTE SR1010 ZX279051 read-only identification audit

maintainers:
  - cnjn <1779895255@qq.com>

description:
  A test-only MDIO child used to perform two fixed Clause 45 identification
  reads from the ZX279051 WAN PHY. The audit has no write or reset operation
  and is not present in normal SR1010 device trees.

properties:
  compatible:
    const: zte,sr1010-zx279051-audit

  reg:
    const: 1

required:
  - compatible
  - reg

additionalProperties: false

examples:
  - |
    mdio {
        #address-cells = <1>;
        #size-cells = <0>;

        wan-audit@1 {
            compatible = "zte,sr1010-zx279051-audit";
            reg = <1>;
        };
    };

...
```

## Documentation/devicetree/bindings/net/zte,zx279133-mdio.yaml
```yaml
# SPDX-License-Identifier: GPL-2.0-only OR BSD-2-Clause
%YAML 1.2
---
$id: http://devicetree.org/schemas/net/zte,zx279133-mdio.yaml#
$schema: http://devicetree.org/meta-schemas/core.yaml#

title: ZTE ZX279133 MDIO controller

maintainers:
  - cnjn <1779895255@qq.com>

description:
  The ZX279133 contains two independent MDIO controllers supporting native
  Clause 22 and Clause 45 transactions.

allOf:
  - $ref: mdio.yaml#

properties:
  compatible:
    const: zte,zx279133-mdio

  reg:
    maxItems: 1

  clocks:
    items:
      - description: Peripheral register interface clock
      - description: MDIO working clock

  clock-names:
    items:
      - const: pclk
      - const: wclk

  resets:
    maxItems: 1

required:
  - compatible
  - reg
  - clocks
  - clock-names
  - resets
  - '#address-cells'
  - '#size-cells'

unevaluatedProperties: false

examples:
  - |
    #include <dt-bindings/clock/zte,zx279133-lsp.h>
    #include <dt-bindings/reset/zte,zx279133-lsp.h>

    mdio@14f01000 {
        compatible = "zte,zx279133-mdio";
        reg = <0x14f01000 0x1000>;
        clocks = <&lsp1_clk ZX279133_LSP1_CLK_MDIO0_PCLK>,
                 <&lsp1_clk ZX279133_LSP1_CLK_MDIO0_WCLK>;
        clock-names = "pclk", "wclk";
        resets = <&lsp1_clk ZX279133_LSP1_RESET_MDIO0>;
        #address-cells = <1>;
        #size-cells = <0>;
    };

...
```

## Documentation/devicetree/bindings/net/zte,zx279133-nppt.yaml
```yaml
# SPDX-License-Identifier: (GPL-2.0-only OR BSD-2-Clause)
%YAML 1.2
---
$id: http://devicetree.org/schemas/net/zte,zx279133-nppt.yaml#
$schema: http://devicetree.org/meta-schemas/core.yaml#

title: ZTE ZX279133 NPPT packet processor

maintainers:
  - cnjn <1779895255@qq.com>

description:
  The ZX279133 NPPT node describes the aggregate resources of the packet
  processor block.

properties:
  $nodename:
    pattern: "^packet-processor@[0-9a-f]+$"

  compatible:
    const: zte,zx279133-nppt

  reg:
    maxItems: 1

  interrupts:
    maxItems: 1

  clocks:
    maxItems: 1

  clock-names:
    const: wclk

required:
  - compatible
  - reg
  - interrupts
  - clocks
  - clock-names

additionalProperties: false

examples:
  - |
    #include <dt-bindings/clock/zte,zx279133-topcrm.h>
    #include <dt-bindings/interrupt-controller/arm-gic.h>

    packet-processor@19000000 {
        compatible = "zte,zx279133-nppt";
        reg = <0x19000000 0x1000000>;
        interrupts = <GIC_SPI 5 IRQ_TYPE_LEVEL_HIGH>;
        clocks = <&topcrm ZX279133_TOPCRM_CLK_PON_WOE1_WCLK>;
        clock-names = "wclk";
        status = "disabled";
    };

...
```

## Documentation/devicetree/bindings/nvmem/layouts/zte,sr1010-tags.yaml
```yaml
# SPDX-License-Identifier: (GPL-2.0-only OR BSD-2-Clause)
%YAML 1.2
---
$id: http://devicetree.org/schemas/nvmem/layouts/zte,sr1010-tags.yaml#
$schema: http://devicetree.org/meta-schemas/core.yaml#

title: ZTE SR1010 factory tags

maintainers:
  - Linux ARM Kernel Mailing List <linux-arm-kernel@lists.infradead.org>

description: |
  The tags partition contains a little-endian header with magic 0x33333333,
  payload length and IEEE CRC32 of the payload. Each payload record contains
  four little-endian 32-bit words (key length, value length, two reserved
  words), followed by the key and value without alignment padding. The
  two-byte keys 0x0100 and 0x0101 identify six-byte Ethernet MAC addresses.
  The MAC offset is discovered by parsing records, rather than fixed in DT.

select: false

properties:
  compatible:
    const: zte,sr1010-tags

  mac-address:
    type: object
    description: MAC from tag 0x0100, assigned to WAN on SR1010.
    additionalProperties: false

  mac-address-lan:
    type: object
    description: MAC from tag 0x0101, assigned to LAN on SR1010.
    additionalProperties: false

required:
  - compatible

additionalProperties: false

examples:
  - |
    nvmem-layout {
        compatible = "zte,sr1010-tags";

        mac-address {
        };
    };
```

## Documentation/devicetree/bindings/nvmem/zte,zx279133-efuse.yaml
```yaml
# SPDX-License-Identifier: (GPL-2.0-only OR BSD-2-Clause)
%YAML 1.2
---
$id: http://devicetree.org/schemas/nvmem/zte,zx279133-efuse.yaml#
$schema: http://devicetree.org/meta-schemas/core.yaml#

title: ZTE ZX279133 eFuse shadow registers

maintainers:
  - cnjn <1779895255@qq.com>

description: |
  The ZX279133 eFuse controller provides 32 read-only, factory-programmed
  shadow words at offsets 0x00 through 0x7c.  The register at offset 0x80 and
  the remainder of the controller resource are control registers and are not
  part of the NVMEM address space.

allOf:
  - $ref: nvmem.yaml#

properties:
  compatible:
    const: zte,zx279133-efuse

  reg:
    maxItems: 1

  clocks:
    items:
      - description: Peripheral register clock
      - description: eFuse shadow working clock

  clock-names:
    items:
      - const: pclk
      - const: wclk

  wp-gpios: false

required:
  - compatible
  - reg
  - clocks
  - clock-names

unevaluatedProperties: false

examples:
  - |
    efuse@14f11000 {
        compatible = "zte,zx279133-efuse";
        reg = <0x14f11000 0x1000>;
        clocks = <&lsp1_clk 4>, <&lsp1_clk 5>;
        clock-names = "pclk", "wclk";
        read-only;

        nvmem-layout {
            compatible = "fixed-layout";
            #address-cells = <1>;
            #size-cells = <1>;

            pvt_ttrim: calibration@44 {
                reg = <0x44 0x4>;
                bits = <10 5>;
            };
        };
    };

...
```

## Documentation/devicetree/bindings/phy/zte,zx279133-pon-serdes.yaml
```yaml
# SPDX-License-Identifier: (GPL-2.0-only OR BSD-2-Clause)
%YAML 1.2
---
$id: http://devicetree.org/schemas/phy/zte,zx279133-pon-serdes.yaml#
$schema: http://devicetree.org/meta-schemas/core.yaml#

title: ZTE ZX279133 PON Ethernet SerDes PHY

maintainers:
  - cnjn <1779895255@qq.com>

description:
  The ZX279133 PON SerDes can be routed to XMAC1 for Ethernet operation. The
  PHY has a SerDes register window, a companion PLL window, and mode words in a
  non-overlapping part of TOPCRM. Shared TOPCRM mux fields are accessed through
  a syscon phandle. The external PLL reference source is firmware-selected and
  is not described as an input clock until its parent is established.

properties:
  $nodename:
    pattern: "^phy@[0-9a-f]+$"

  compatible:
    const: zte,zx279133-pon-serdes

  reg:
    items:
      - description: PON SerDes registers
      - description: PON SerDes companion PLL registers
      - description: TOPCRM PON PLL mode words at offsets 0xc0 and 0xc4

  reg-names:
    items:
      - const: serdes
      - const: pll
      - const: topcrm-mode

  clocks:
    maxItems: 1

  clock-names:
    const: pclk

  resets:
    maxItems: 2

  reset-names:
    items:
      - const: serdes
      - const: apb

  zte,topcrm:
    $ref: /schemas/types.yaml#/definitions/phandle
    description:
      Phandle to TOPCRM syscon for masked updates to shared PON SerDes mode and
      clock-selection fields outside the dedicated mode-word resource.

  '#phy-cells':
    const: 0

required:
  - compatible
  - reg
  - reg-names
  - clocks
  - clock-names
  - resets
  - reset-names
  - zte,topcrm
  - '#phy-cells'

additionalProperties: false

examples:
  - |
    #include <dt-bindings/reset/zte,zx279133-topcrm.h>

    pclk {
        compatible = "fixed-clock";
        #clock-cells = <0>;
        clock-frequency = <125000000>;
    };

    topcrm: syscon@10e10000 {
        compatible = "syscon";
        reg = <0x10e10000 0x60>;
    };

    local_reset: reset-controller@10e10070 {
        compatible = "zte,zx296718-reset";
        reg = <0x10e10070 0x8>;
        #reset-cells = <1>;
    };

    phy@16000000 {
        compatible = "zte,zx279133-pon-serdes";
        reg = <0x16000000 0x10000>,
              <0x16010000 0x10000>,
              <0x10e100c0 0x8>;
        reg-names = "serdes", "pll", "topcrm-mode";
        clocks = <&pclk>;
        clock-names = "pclk";
        resets = <&local_reset ZX279133_LOCAL_RESET_PON_SERDES>,
                 <&local_reset ZX279133_LOCAL_RESET_PON_SERDES_APB>;
        reset-names = "serdes", "apb";
        zte,topcrm = <&topcrm>;
        #phy-cells = <0>;
    };
...
```

## Documentation/devicetree/bindings/phy/zte,zx279133-uni-serdes.yaml
```yaml
# SPDX-License-Identifier: (GPL-2.0-only OR BSD-2-Clause)
%YAML 1.2
---
$id: http://devicetree.org/schemas/phy/zte,zx279133-uni-serdes.yaml#
$schema: http://devicetree.org/meta-schemas/core.yaml#

title: ZTE ZX279133 Uni SerDes PHY

maintainers:
  - cnjn <1779895255@qq.com>

description:
  The ZX279133 Uni SerDes provides the internal serial link used by the
  Ethernet MACs. The provider owns the Uni SerDes register window, its
  peripheral and reference clocks, and the receive/transmit reset lines.
  MAC and PCS configuration is performed by their respective consumers.

properties:
  $nodename:
    pattern: "^phy@[0-9a-f]+$"

  compatible:
    const: zte,zx279133-uni-serdes

  reg:
    maxItems: 1

  clocks:
    items:
      - description: Uni SerDes peripheral clock
      - description: Uni SerDes 50 MHz reference clock

  clock-names:
    items:
      - const: pclk
      - const: ref50m

  resets:
    items:
      - description: Uni SerDes receive reset
      - description: Uni SerDes transmit reset

  reset-names:
    items:
      - const: rx
      - const: tx

  '#phy-cells':
    const: 0

required:
  - compatible
  - reg
  - clocks
  - clock-names
  - resets
  - reset-names
  - '#phy-cells'

additionalProperties: false

examples:
  - |
    #include <dt-bindings/clock/zte,zx279133-topcrm.h>
    #include <dt-bindings/reset/zte,zx279133-topcrm.h>

    phy@16100000 {
        compatible = "zte,zx279133-uni-serdes";
        reg = <0x16100000 0x100000>;
        clocks = <&topcrm ZX279133_TOPCRM_CLK_UNI_SERDES_PCLK>,
                 <&topcrm ZX279133_TOPCRM_CLK_UNI_SERDES_50M>;
        clock-names = "pclk", "ref50m";
        resets = <&local_reset ZX279133_LOCAL_RESET_UNI_SERDES_RX>,
                 <&local_reset ZX279133_LOCAL_RESET_UNI_SERDES_TX>;
        reset-names = "rx", "tx";
        #phy-cells = <0>;
    };
...
```

## Documentation/devicetree/bindings/pinctrl/zte,zx279133-pinctrl.yaml
```yaml
# SPDX-License-Identifier: (GPL-2.0-only OR BSD-2-Clause)
%YAML 1.2
---
$id: http://devicetree.org/schemas/pinctrl/zte,zx279133-pinctrl.yaml#
$schema: http://devicetree.org/meta-schemas/core.yaml#

title: ZTE ZX279133 pin controller

maintainers:
  - ZTE Linux Team <zte.linux@gmail.com>

description: |
  The ZX279133 pin controller contains 70 pins in six physical pin banks.
  This binding describes GPIO muxing, the SPI flash controller pins, and the
  PWM outputs. Other peripheral mux selections established by firmware remain
  unchanged.

properties:
  compatible:
    const: zte,zx279133-pinctrl

  reg:
    maxItems: 1

patternProperties:
  '-pins$':
    type: object
    $ref: pinmux-node.yaml#
    additionalProperties: false

    properties:
      function:
        enum: [gpio, pwm, spifc]

      pins:
        minItems: 1
        maxItems: 70
        items:
          enum:
            - p0-0
            - p0-1
            - p0-2
            - p0-3
            - p0-4
            - p0-5
            - p0-6
            - p0-7
            - p0-8
            - p0-9
            - p0-10
            - p0-11
            - p0-12
            - p0-13
            - p0-14
            - p1-0
            - p1-1
            - p1-2
            - p1-3
            - p1-4
            - p1-5
            - p1-6
            - p1-7
            - p1-8
            - p1-9
            - p2-0
            - p2-1
            - p2-2
            - p2-3
            - p2-4
            - p2-5
            - p2-6
            - p2-7
            - p2-8
            - p2-9
            - p2-10
            - p2-11
            - p2-12
            - p2-13
            - p2-14
            - p2-15
            - p2-16
            - p2-17
            - p3-0
            - p3-1
            - p3-2
            - p3-3
            - p3-4
            - p3-5
            - p3-6
            - p3-7
            - p3-8
            - p3-9
            - p3-10
            - p3-11
            - p3-12
            - p4-0
            - p4-1
            - p4-2
            - p4-3
            - p4-4
            - p4-5
            - p4-6
            - p4-7
            - p4-8
            - p4-9
            - p5-0
            - p5-1
            - p5-2
            - p5-3

    allOf:
      - if:
          properties:
            function:
              const: spifc
        then:
          properties:
            pins:
              items:
                enum: [p3-9, p3-10, p3-11, p3-12, p4-0, p4-1]
      - if:
          properties:
            function:
              const: pwm
        then:
          properties:
            pins:
              items:
                enum: [p0-8, p0-9, p0-12, p0-13]

    required:
      - function
      - pins

required:
  - compatible
  - reg

allOf:
  - $ref: pinctrl.yaml#

additionalProperties: false

examples:
  - |
    pinctrl@10e20000 {
        compatible = "zte,zx279133-pinctrl";
        reg = <0x10e20000 0x1000>;

        example-pins {
            function = "spifc";
            pins = "p3-9", "p3-10", "p3-11", "p3-12", "p4-0", "p4-1";
        };

        pwm-pins {
            function = "pwm";
            pins = "p0-9";
        };
    };
```
