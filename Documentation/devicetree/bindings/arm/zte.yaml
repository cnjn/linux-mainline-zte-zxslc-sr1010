## Documentation/devicetree/bindings/arm/zte.yaml
```yaml
# SPDX-License-Identifier: GPL-2.0-only OR BSD-2-Clause
%YAML 1.2
---
$id: http://devicetree.org/schemas/arm/zte.yaml#
$schema: http://devicetree.org/meta-schemas/core.yaml#

title: ZTE platforms

maintainers:
  - ZTE Linux Team <zte.linux@gmail.com>

properties:
  $nodename:
    const: '/'

  compatible:
    oneOf:
      - description: ZTE ZXSLC SR1010
        items:
          - const: zte,zx279133-sr1010
          - const: zte,zx279133

additionalProperties: true

...
```

## Documentation/devicetree/bindings/clock/zte,zx279133-lsp-clk.yaml
```yaml
# SPDX-License-Identifier: (GPL-2.0-only OR BSD-2-Clause)
%YAML 1.2
---
$id: http://devicetree.org/schemas/clock/zte,zx279133-lsp-clk.yaml#
$schema: http://devicetree.org/meta-schemas/core.yaml#

title: ZTE ZX279133 low-speed peripheral clock controller

maintainers:
  - cnjn <1779895255@qq.com>

description:
  The low-speed peripheral (LSP) clock controller supplies bus and working
  clocks to UART, timer, and flash controller peripherals. The UART working
  clock has a mux selecting either the 25 MHz or 100 MHz LSP source. The
  SPI flash controller working clock has a divider, and both peripherals have
  separate working and bus clock gates.

properties:
  compatible:
    items:
      - const: zte,zx279133-lsp-clk
      - const: syscon

  reg:
    maxItems: 1

  clocks:
    items:
      - description: LSP peripheral bus clock
      - description: 25 MHz LSP working clock
      - description: 100 MHz LSP working clock
      - description: SPI flash controller working clock

  clock-names:
    items:
      - const: pclk
      - const: wclk25
      - const: wclk100
      - const: spifc_wclk

  '#clock-cells':
    const: 1
    description:
      See include/dt-bindings/clock/zte,zx279133-lsp.h for valid indices.

  '#reset-cells':
    const: 1

required:
  - compatible
  - reg
  - clocks
  - clock-names
  - '#clock-cells'
  - '#reset-cells'

additionalProperties: false

examples:
  - |
    #include <dt-bindings/clock/zte,zx279133-topcrm.h>

    clock-controller@10d00000 {
        compatible = "zte,zx279133-lsp-clk", "syscon";
        reg = <0x10d00000 0x100>;
        clocks = <&topcrm ZX279133_TOPCRM_CLK_LSP0_PCLK>,
                 <&topcrm ZX279133_TOPCRM_CLK_LSP0_25M>,
                 <&topcrm ZX279133_TOPCRM_CLK_LSP0_100M>,
                 <&topcrm ZX279133_TOPCRM_CLK_SPIFC_WCLK>;
        clock-names = "pclk", "wclk25", "wclk100", "spifc_wclk";
        #clock-cells = <1>;
        #reset-cells = <1>;
    };
```

## Documentation/devicetree/bindings/clock/zte,zx279133-lsp1-clk.yaml
```yaml
# SPDX-License-Identifier: GPL-2.0-only OR BSD-2-Clause
%YAML 1.2
---
$id: http://devicetree.org/schemas/clock/zte,zx279133-lsp1-clk.yaml#
$schema: http://devicetree.org/meta-schemas/core.yaml#

title: ZTE ZX279133 LSP1 clock and reset controller

maintainers:
  - cnjn <1779895255@qq.com>

description:
  The LSP1 clock controller supplies bus and working clocks to the ZX279133
  watchdog timers, efuse controller, PWM controller, and MDIO controllers. Each
  watchdog working clock has a 10-bit linear divider followed by a gate. Each
  MDIO working clock has a read-only 7-bit linear divider followed by a gate.
  The efuse and PWM peripheral and working clocks each have a gate. The
  controller also provides the MDIO reset lines.

properties:
  compatible:
    const: zte,zx279133-lsp1-clk

  reg:
    maxItems: 1

  clocks:
    items:
      - description: LSP1 peripheral bus clock
      - description: 32.768 kHz watchdog working clock
      - description: 25 MHz efuse working clock
      - description: 100 MHz MDIO working clock source

  clock-names:
    items:
      - const: pclk
      - const: wclk32k
      - const: wclk25m
      - const: wclk100m

  '#clock-cells':
    const: 1
    description:
      See include/dt-bindings/clock/zte,zx279133-lsp.h for valid indices.

  '#reset-cells':
    const: 1
    description:
      See include/dt-bindings/reset/zte,zx279133-lsp.h for valid indices.

required:
  - compatible
  - reg
  - clocks
  - clock-names
  - '#clock-cells'
  - '#reset-cells'

additionalProperties: false

examples:
  - |
    #include <dt-bindings/clock/zte,zx279133-topcrm.h>

    clock-controller@14f00000 {
        compatible = "zte,zx279133-lsp1-clk";
        reg = <0x14f00000 0x100>;
        clocks = <&topcrm ZX279133_TOPCRM_CLK_LSP1_PCLK>,
                 <&topcrm ZX279133_TOPCRM_CLK_LSP1_32K>,
                 <&topcrm ZX279133_TOPCRM_CLK_LSP1_25M>,
                 <&topcrm ZX279133_TOPCRM_CLK_LSP1_100M>;
        clock-names = "pclk", "wclk32k", "wclk25m", "wclk100m";
        #clock-cells = <1>;
        #reset-cells = <1>;
    };

...
```

## Documentation/devicetree/bindings/clock/zte,zx279133-topcrm.yaml
```yaml
# SPDX-License-Identifier: (GPL-2.0-only OR BSD-2-Clause)
%YAML 1.2
---
$id: http://devicetree.org/schemas/clock/zte,zx279133-topcrm.yaml#
$schema: http://devicetree.org/meta-schemas/core.yaml#

title: ZTE ZX279133 top clock and reset manager

maintainers:
  - cnjn <1779895255@qq.com>

description:
  The top clock and reset manager (TOPCRM) supplies clocks to the ZX279133
  low-speed peripheral controllers, SPI flash controller, PVT temperature
  sensor, USB host controller, interconnect, and Cortex-A53 CPUs. Fixed PLL
  roots feed fixed-factor branches followed by read-only system, CCI, and CPU
  muxes. The system HCLK and PCLK use read-only even dividers. This preserves
  the firmware-selected boot topology without allowing Linux to reprogram a
  PLL, mux, or system divider. The PVT working clock uses a separate read-only
  divider followed by a gate.

properties:
  compatible:
    items:
      - const: zte,zx279133-topcrm
      - const: syscon

  reg:
    maxItems: 1

  clocks:
    items:
      - description: 25 MHz oscillator
      - description: Fixed 2 GHz low-speed peripheral PLL root
      - description: Fixed 1.376256 GHz PLL root
      - description: Fixed 2.5 GHz FPP PLL root
      - description: Firmware-configured 2 GHz CPU PLL root

  clock-names:
    items:
      - const: osc25m
      - const: pll-lsp
      - const: pll-1376m
      - const: pll-fpp
      - const: pll-cpu

  '#clock-cells':
    const: 1
    description:
      See include/dt-bindings/clock/zte,zx279133-topcrm.h for valid indices.

required:
  - compatible
  - reg
  - clocks
  - clock-names
  - '#clock-cells'

additionalProperties: false

examples:
  - |
    clock-controller@10e10000 {
        compatible = "zte,zx279133-topcrm", "syscon";
        reg = <0x10e10000 0x60>;
        clocks = <&osc25m>, <&pll_lsp>, <&pll_1376m>, <&pll_fpp>, <&pll_cpu>;
        clock-names = "osc25m", "pll-lsp", "pll-1376m", "pll-fpp",
                      "pll-cpu";
        #clock-cells = <1>;
    };

...
```

## Documentation/devicetree/bindings/gpio/zte,zx279133-gpio.yaml
```yaml
# SPDX-License-Identifier: (GPL-2.0-only OR BSD-2-Clause)
%YAML 1.2
---
$id: http://devicetree.org/schemas/gpio/zte,zx279133-gpio.yaml#
$schema: http://devicetree.org/meta-schemas/core.yaml#

title: ZTE ZX279133 GPIO controller

maintainers:
  - ZTE Linux Team <zte.linux@gmail.com>

description: |
  The ZX279133 has five GPIO banks with 16-bit registers and one cascaded
  interrupt per bank. Four banks expose 16 lines and the final bank exposes
  six lines, for 70 GPIOs in total.

properties:
  $nodename:
    pattern: "^gpio@[0-9a-f]+$"

  compatible:
    const: zte,zx279133-gpio

  reg:
    maxItems: 1

  interrupts:
    maxItems: 1

  gpio-controller: true

  '#gpio-cells':
    const: 2

  gpio-ranges:
    minItems: 1
    maxItems: 3

  ngpios:
    enum: [6, 16]

  interrupt-controller: true

  '#interrupt-cells':
    const: 2

required:
  - compatible
  - reg
  - interrupts
  - gpio-controller
  - '#gpio-cells'
  - gpio-ranges
  - ngpios
  - interrupt-controller
  - '#interrupt-cells'

additionalProperties: false

examples:
  - |
    gpio@10d10080 {
        compatible = "zte,zx279133-gpio";
        reg = <0x10d10080 0x40>;
        interrupts = <0 36 4>;
        gpio-controller;
        #gpio-cells = <2>;
        gpio-ranges = <&pinctrl 0 28 16>;
        ngpios = <16>;
        interrupt-controller;
        #interrupt-cells = <2>;
    };
```

## Documentation/devicetree/bindings/hwmon/zte,zx279133-pvt.yaml
```yaml
# SPDX-License-Identifier: (GPL-2.0-only OR BSD-2-Clause)
%YAML 1.2
---
$id: http://devicetree.org/schemas/hwmon/zte,zx279133-pvt.yaml#
$schema: http://devicetree.org/meta-schemas/core.yaml#

title: ZTE ZX279133 CLN22ULP PVT sensor

maintainers:
  - cnjn <1779895255@qq.com>

description: |
  The ZX279133 CLN22ULP PVT block contains one-shot die-temperature and
  supply-voltage converters.  The driver starts a conversion for each read
  and exposes standard read-only hwmon temperature and voltage inputs.  The
  required ttrim NVMEM cell is a five-bit temperature calibration value from
  the ZX279133 efuse controller.  The voltage input measures the PVT macro's
  supply; the binding does not identify that supply with a board-level rail.
  Thermal trips and cooling policy are described by separate thermal-zone
  nodes and are intentionally not part of this binding.

properties:
  compatible:
    const: zte,zx279133-pvt

  reg:
    maxItems: 1

  clocks:
    items:
      - description: Peripheral register clock
      - description: Temperature conversion working clock

  clock-names:
    items:
      - const: pclk
      - const: wclk

  nvmem-cells:
    maxItems: 1

  nvmem-cell-names:
    items:
      - const: ttrim

  '#thermal-sensor-cells':
    const: 0

required:
  - compatible
  - reg
  - clocks
  - clock-names
  - nvmem-cells
  - nvmem-cell-names
  - '#thermal-sensor-cells'

additionalProperties: false

examples:
  - |
    pvt@10e70000 {
        compatible = "zte,zx279133-pvt";
        reg = <0x10e70000 0x10000>;
        clocks = <&topcrm 10>, <&topcrm 5>;
        clock-names = "pclk", "wclk";
        nvmem-cells = <&pvt_ttrim>;
        nvmem-cell-names = "ttrim";
        #thermal-sensor-cells = <0>;
        status = "disabled";
    };

...
```

## Documentation/devicetree/bindings/mfd/zte,zx279133-wdt-reset.yaml
```yaml
# SPDX-License-Identifier: GPL-2.0-only OR BSD-2-Clause
%YAML 1.2
---
$id: http://devicetree.org/schemas/mfd/zte,zx279133-wdt-reset.yaml#
$schema: http://devicetree.org/meta-schemas/core.yaml#

title: ZTE ZX279133 watchdog reset routing register

maintainers:
  - cnjn <1779895255@qq.com>

description:
  The four-byte watchdog reset routing register enables each watchdog timer's
  reset output. It is exposed as a syscon so the watchdog driver can configure
  its corresponding route without mapping unrelated TOPCRM registers.

properties:
  compatible:
    items:
      - const: zte,zx279133-wdt-reset
      - const: syscon

  reg:
    maxItems: 1

required:
  - compatible
  - reg

additionalProperties: false

examples:
  - |
    syscon@10e10208 {
        compatible = "zte,zx279133-wdt-reset", "syscon";
        reg = <0x10e10208 0x4>;
    };

...
```

## Documentation/devicetree/bindings/mtd/spi-nand.yaml
```yaml
# SPDX-License-Identifier: (GPL-2.0-only OR BSD-2-Clause)
%YAML 1.2
---
$id: http://devicetree.org/schemas/mtd/spi-nand.yaml#
$schema: http://devicetree.org/meta-schemas/core.yaml#

title: SPI-NAND flash

maintainers:
  - Miquel Raynal <miquel.raynal@bootlin.com>

allOf:
  - $ref: nand-chip.yaml#
  - $ref: /schemas/spi/spi-peripheral-props.yaml#
  - if:
      anyOf:
        - required:
            - read-only
        - required:
            - partitions-only
    then:
      required:
        - partitions
      properties:
        partitions:
          properties:
            compatible:
              contains:
                const: fixed-partitions

properties:
  compatible:
    const: spi-nand

  reg:
    description: Encode the chip-select line on the SPI bus
    maxItems: 1

  read-only:
    type: boolean
    description:
      Operate the chip in strict read-only mode. Reset and commands needed to
      identify and read the device are permitted, but commands that alter
      feature registers, protection state, OTP data, or the main NAND array
      are not. Probe succeeds only if the post-reset feature state already
      permits reliable on-die-ECC-protected main-array and bad block marker
      reads. Raw reads that would require disabling on-die ECC are not
      supported. A fixed partition map is required and only its partitions are
      registered, so parser failure cannot expose the whole chip.

  partitions-only:
    type: boolean
    description:
      The firmware requires that only explicitly described fixed partitions
      are exposed. Initialization fails if the map is missing or cannot be
      parsed, instead of exposing the whole flash device. This permits a
      writable chip to expose only explicitly described partitions.

required:
  - compatible
  - reg

unevaluatedProperties: false
```

## Documentation/devicetree/bindings/net/dsa/zte,zx279133-rtl8372n.yaml
```yaml
# SPDX-License-Identifier: (GPL-2.0-only OR BSD-2-Clause)
%YAML 1.2
---
$id: http://devicetree.org/schemas/net/dsa/zte,zx279133-rtl8372n.yaml#
$schema: http://devicetree.org/meta-schemas/core.yaml#

title: RTL8372N switch on the ZTE ZX279133 NPPT LAN path

maintainers:
  - cnjn <1779895255@qq.com>

description:
  The RTL8372N CPU port connects to ZX279133 XMAC0. Switch management uses the
  SoC MDIO controller's indirect SMI transport, represented by zte,mdio-handle.
  The CPU conduit is a dedicated netdev owned by the NPPT Ethernet controller
  rather than the WAN netdev.

properties:
  compatible:
    const: zte,zx279133-rtl8372n

  zte,mdio-handle:
    $ref: /schemas/types.yaml#/definitions/phandle
    description: MDIO child implementing the RTL8372N indirect SMI transport

  reset-gpios:
    maxItems: 1
    description: Active-low RTL8372N hardware reset

allOf:
  - $ref: dsa.yaml#/$defs/ethernet-ports

required:
  - compatible
  - zte,mdio-handle
  - reset-gpios

unevaluatedProperties: false

examples:
  - |
    #include <dt-bindings/gpio/gpio.h>

    mdio {
        #address-cells = <1>;
        #size-cells = <0>;

        rtl8372n_smi: switch-controller@1d {
            compatible = "realtek,rtl8372n";
            reg = <0x1d>;
        };
    };

    ethernet {
        #address-cells = <1>;
        #size-cells = <0>;

        lan_cpu: ethernet-lan-cpu {
            compatible = "zte,zx279133-lan-conduit";
        };

        switch {
            compatible = "zte,zx279133-rtl8372n";
            zte,mdio-handle = <&rtl8372n_smi>;
            reset-gpios = <&gpio1 1 GPIO_ACTIVE_LOW>;

            ports {
                #address-cells = <1>;
                #size-cells = <0>;

                port@7 {
                    reg = <7>;
                    label = "lan1";
                    phy-mode = "internal";
                    fixed-link {
                        speed = <2500>;
                        full-duplex;
                    };
                };

                port@8 {
                    reg = <8>;
                    ethernet = <&lan_cpu>;
                    phy-mode = "10gbase-r";
                    fixed-link {
                        speed = <10000>;
                        full-duplex;
                    };
                };
            };
        };
    };
...
```
