## Documentation/devicetree/bindings/usb/zte,zx279133-xhci.yaml
```yaml
# SPDX-License-Identifier: (GPL-2.0-only OR BSD-2-Clause)
%YAML 1.2
---
$id: http://devicetree.org/schemas/usb/zte,zx279133-xhci.yaml#
$schema: http://devicetree.org/meta-schemas/core.yaml#

title: ZTE ZX279133 USB xHCI controller

maintainers:
  - cnjn <1779895255@qq.com>

description:
  The ZX279133 xHCI controller has separate register, core AXI, and CCI AXI
  interface clocks. All three clocks must remain enabled while the controller
  can issue DMA transactions.

allOf:
  - $ref: usb-xhci.yaml#

properties:
  compatible:
    const: zte,zx279133-xhci

  reg:
    maxItems: 1

  interrupts:
    maxItems: 1

  clocks:
    items:
      - description: Core AXI clock
      - description: Register interface clock
      - description: CCI AXI interface clock

  clock-names:
    items:
      - const: core
      - const: reg
      - const: cci

  dma-coherent: true

required:
  - compatible
  - reg
  - interrupts
  - clocks
  - clock-names

unevaluatedProperties: false

examples:
  - |
    usb@15010000 {
        compatible = "zte,zx279133-xhci";
        reg = <0x15010000 0x4000>;
        interrupts = <0 65 4>;
        clocks = <&topcrm 9>, <&topcrm 7>, <&topcrm 8>;
        clock-names = "core", "reg", "cci";
        dma-coherent;
    };

...
```

## Documentation/devicetree/bindings/watchdog/zte,zx279133-watchdog.yaml
```yaml
# SPDX-License-Identifier: GPL-2.0-only OR BSD-2-Clause
%YAML 1.2
---
$id: http://devicetree.org/schemas/watchdog/zte,zx279133-watchdog.yaml#
$schema: http://devicetree.org/meta-schemas/core.yaml#

title: ZTE ZX279133 watchdog

maintainers:
  - cnjn <1779895255@qq.com>

allOf:
  - $ref: watchdog.yaml#

properties:
  compatible:
    const: zte,zx279133-watchdog

  reg:
    maxItems: 1

  clocks:
    items:
      - description: Peripheral bus clock
      - description: Watchdog counter clock

  clock-names:
    items:
      - const: pclk
      - const: wdtclk

  zte,reset-controller:
    $ref: /schemas/types.yaml#/definitions/phandle
    description: System controller register block containing this watchdog's
      reset route

  zte,reset-offset:
    $ref: /schemas/types.yaml#/definitions/uint32
    description: Offset of the watchdog reset route register in the system
      controller block

  zte,reset-mask:
    $ref: /schemas/types.yaml#/definitions/uint32
    description: Bit enabling this watchdog's reset output
    minimum: 1

  zte,restart-watchdog:
    type: boolean
    description: Use this watchdog as the system restart handler

required:
  - compatible
  - reg
  - clocks
  - clock-names
  - zte,reset-controller
  - zte,reset-offset
  - zte,reset-mask

unevaluatedProperties: false

examples:
  - |
    watchdog@14f09000 {
        compatible = "zte,zx279133-watchdog";
        reg = <0x14f09000 0x1000>;
        clocks = <&lsp1_clk 0>, <&lsp1_clk 1>;
        clock-names = "pclk", "wdtclk";
        zte,reset-controller = <&wdt_reset>;
        zte,reset-offset = <0x0>;
        zte,reset-mask = <0x10>;
        zte,restart-watchdog;
        timeout-sec = <10>;
    };

...
```

## drivers/net/ethernet/zte/Kconfig
```kconfig
# SPDX-License-Identifier: GPL-2.0-only

config NET_VENDOR_ZTE
	bool "ZTE Ethernet devices"
	default y
	help
	  Enable support for Ethernet controllers integrated in ZTE SoCs.
	  This option controls the visibility of the individual ZTE Ethernet
	  drivers and does not build a driver by itself. Select the controller
	  option below for the target SoC.

if NET_VENDOR_ZTE

config ZTE_ZX279133_ETH
	tristate "ZTE ZX279133 NPPT Ethernet support"
	depends on OF && HAS_IOMEM && HAS_DMA
	depends on COMMON_CLK_ZX279133
	depends on PHY_ZX279133_PON_SERDES
	depends on PCS_XPCS
	select PAGE_POOL
	help
	  Enable support for the NPPT Ethernet controller and IDM packet DMA
	  engine in the ZTE ZX279133 SoC. The driver provides phylink MAC/PCS
	  integration, TX completion, page-pool RX, and the SR1010 WAN path.
	  It also owns the shared packet-processing resources used by LAN.

config ZTE_ZX279133_LAN_CONDUIT
	bool "ZTE ZX279133 XMAC0 LAN conduit"
	depends on ZTE_ZX279133_ETH
	default y
	help
	  Build the XMAC0 LAN conduit netdev as a child of the ZX279133
	  NPPT controller. The conduit is used as a DSA CPU-facing netdev.
	  Shared DMA and datapath ownership remains in the parent driver,
	  which coordinates WAN and LAN lifecycle and queue accounting.

config ZTE_ZX279133_RTL8372N
	tristate "ZTE ZX279133 RTL8372N DSA switch driver"
	depends on ZTE_ZX279133_ETH
	select ZTE_ZX279133_LAN_CONDUIT
	depends on PHY_ZX279133_UNI_SERDES
	depends on PCS_XPCS
	depends on NET_DSA
	select NET_DSA_TAG_ZX279133_RTL8372N
	help
	  Build the RTL8372N DSA switch driver for the SR1010 LAN path. The
	  driver owns the external switch reset, XMAC0/XPCS0/Uni-SerDes link,
	  physical ports 4 through 7, and CPU port 8. It registers four DSA
	  user ports through the dedicated ZX279133 LAN conduit.

endif
```

## drivers/phy/zte/Kconfig
```kconfig
# SPDX-License-Identifier: GPL-2.0-only

config PHY_ZX279133_PON_SERDES
	tristate "ZTE ZX279133 PON SerDes PHY"
	depends on OF && HAS_IOMEM
	depends on COMMON_CLK_ZX279133 || COMPILE_TEST
	depends on MFD_SYSCON
	select GENERIC_PHY
	help
	  Enable the Ethernet mode of the PON SerDes integrated in the ZTE
	  ZX279133 SoC. The driver supports the SGMII and 2.5GBASE-X profiles
	  used by the SR1010 WAN path. It controls the SerDes clock, local
	  resets, PLL mode words, and lock polling through the Generic PHY
	  framework.
```

## drivers/soc/zte/Kconfig
```kconfig
# SPDX-License-Identifier: GPL-2.0-only

config ZTE_ZX279133_PWM_AUDIT
	tristate "ZTE ZX279133 PWM read-only audit"
	depends on ARM64 && COMMON_CLK && OF && HAS_IOMEM
	help
	  Build a diagnostic driver that reads and logs raw MODE, PERIOD, and DUTY
	  registers for all ZX279133 PWM channels. It is intended to audit a
	  firmware-configured controller before a functional PWM driver is added.
	  It obtains clock handles only to verify the firmware-enabled gate state;
	  it never prepares or enables them. The driver registers no PWM chip,
	  requests no resets or pinctrl, and performs no hardware writes.

config ZTE_ZX279133_XPCS_NPPT_AUDIT
	bool "ZTE ZX279133 XPCS and NPPT read-only audit"
	depends on COMMON_CLK_ZX279133
	depends on (ARM64 || COMPILE_TEST) && HAS_IOMEM
	help
	  Build a diagnostic driver exposing a trigger-once sysfs snapshot of
	  firmware-configured XPCS and NPPT registers. A dedicated external build
	  overlay instantiates this driver; normal system device trees do not.
	  Target data reads are trigger-once, and clock validation checks are not
	  included in data_reads. The driver never changes clock or hardware state.
```

## out/sr1010-zxdbg.its
```
/dts-v1/;

/ {
	description = "ZXSLC SR1010 mainline RAM boot";
	#address-cells = <1>;

	images {
		kernel {
			description = "Linux arm64 Image with mainline diagnostic initramfs";
			data = /incbin/("/Volumes/code/zx279133/out/Image.gz");
			type = "kernel";
			arch = "arm64";
			os = "linux";
			compression = "gzip";
			load = <0x80200000>;
			entry = <0x80200000>;
			hash-1 {
				algo = "sha256";
			};
		};

		fdt {
			description = "ZX279133 SR1010 mainline device tree";
			data = /incbin/("/Volumes/code/zx279133/out/zx279133-sr1010.dtb");
			type = "flat_dt";
			arch = "arm64";
			compression = "none";
			hash-1 {
				algo = "sha256";
			};
		};
	};

	configurations {
		default = "conf";
		conf {
			description = "SR1010 mainline SoC and diagnostic monitor";
			kernel = "kernel";
			fdt = "fdt";
		};
	};
};
```
